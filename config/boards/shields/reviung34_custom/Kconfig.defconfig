## config/boards/shields/reviung34_custom/Kconfig.defconfig
```kconfig
if SHIELD_REVIUNG34_CUSTOM

config ZMK_KEYBOARD_NAME
    default "REVIUNG34"

endif
```

## config/boards/shields/reviung34_custom/Kconfig.shield
```kconfig
config SHIELD_REVIUNG34_CUSTOM
    def_bool $(shields_list_contains,reviung34_custom)
```
